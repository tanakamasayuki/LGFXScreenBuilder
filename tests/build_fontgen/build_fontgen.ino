// Device-side check for a generated embedded font (SPEC §8.7.7).
//
// The browser tests prove the generator emits the bytes it means to, and the
// u8g2 round trip proves those bytes decode correctly against a mirror of
// LovyanGFX's decoder. This closes the loop on real LovyanGFX: the emitted
// header must compile, link, and actually draw — including ℃ (U+2103), the
// character the "units" preset exists for.
#include <LovyanGFX.hpp>
#include <LGFX_AUTODETECT.hpp>

// Generated by docs/fontgen.html from Roboto (Apache-2.0) at a 16px CHARACTER
// height (which yields a 26px line box) with the ASCII + Latin-1 + units sets.
// Regenerate with that page if the encoder changes; see
// tests/build_fontgen/README.md.
#include "TestPanelFont.h"

#include <stdio.h>
#include <sys/stat.h>

static LGFX lcd;

static bool savePng(LovyanGFX &src, const char *path)
{
  size_t len = 0;
  void *png = src.createPng(&len, 0, 0, src.width(), src.height());
  if (!png || len == 0)
  {
    return false;
  }
  FILE *fp = fopen(path, "wb");
  bool ok = false;
  if (fp)
  {
    ok = (fwrite(png, 1, len, fp) == len);
    fclose(fp);
  }
  free(png);
  return ok;
}

// Ink coverage of a string drawn on a cleared screen — 0 means the glyph is
// missing or drew nothing, which is the failure this test exists to catch.
static int inkOf(const char *text)
{
  lcd.fillScreen(TFT_BLACK);
  lcd.setFont(&TestPanelFont);
  lcd.setTextColor(TFT_WHITE, TFT_BLACK);
  lcd.setTextDatum(textdatum_t::top_left);
  lcd.drawString(text, 4, 4);
  int n = 0;
  const int w = lcd.width() < 200 ? lcd.width() : 200;
  const int h = lcd.height() < 40 ? lcd.height() : 40;
  for (int y = 0; y < h; ++y)
  {
    for (int x = 0; x < w; ++x)
    {
      if (lcd.readPixel(x, y) != 0)
      {
        ++n;
      }
    }
  }
  return n;
}

void setup()
{
  Serial.begin(115200);
  Serial.println("TEST start build_fontgen");

  mkdir("output", 0755);
  lcd.init();
  Serial.printf("PANEL %dx%d\n", (int)lcd.width(), (int)lcd.height());

  lcd.setFont(&TestPanelFont);
  // The line box is derived from the glyphs the font actually carries, so it is
  // wider than the 16px characters but nowhere near what the family's declared
  // metrics would reserve. What matters on the device is that LovyanGFX reads
  // back the same number the generator wrote.
  Serial.printf("HEIGHT %d\n", (int)lcd.fontHeight());
  Serial.printf("WIDTH_ASCII %d\n", (int)lcd.textWidth("Hello"));
  Serial.printf("WIDTH_DEGREE %d\n", (int)lcd.textWidth("25.6\xe2\x84\x83"));

  Serial.printf("INK_ASCII %d\n", inkOf("Hello 12:34"));
  Serial.printf("INK_CELSIUS %d\n", inkOf("\xe2\x84\x83"));
  Serial.printf("INK_BAR %d\n", inkOf("Il1"));

  lcd.fillScreen(TFT_BLACK);
  lcd.setFont(&TestPanelFont);
  lcd.setTextColor(TFT_WHITE, TFT_BLACK);
  lcd.setTextDatum(textdatum_t::top_left);
  lcd.drawString("25.6\xe2\x84\x83 12:34", 4, 4);
  lcd.drawString("Hello, LGFX!", 4, 24);
  Serial.printf("PNG saved=%d\n", savePng(lcd, "output/fontgen.png"));

  Serial.println("TEST done");
}

void loop()
{
  delay(1000);
}
