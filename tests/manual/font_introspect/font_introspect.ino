// Font-catalog host introspection harness (SPEC §8.7.2, phase 1b).
//
// For every preset font (table generated by gen.py into fonts_table.h) this
// collects, on the lang-ship host LovyanGFX backend:
//   - default metrics (height / baseline / x_advance / y_advance) via IFont,
//   - printable-ASCII coverage count + a CJK probe via updateFontMetric, and
//   - a cropped sample PNG rendered at the font's native size.
// Metrics go to output/metrics.jsonl (one JSON object per font); samples go to
// output/samples/<name>.png. The Python side (test_font_introspect.py) reads
// these, packs the samples into one atlas, and writes the catalog metrics JSON.
// Serial carries only sync markers so the dut fixture can gate on progress.
#include <LovyanGFX.hpp>
#include <LGFX_AUTODETECT.hpp>
#include "fonts_table.h"

#include <stdio.h>
#include <sys/stat.h>
#include <string.h>

using lgfx::v1::FontMetrics;
using lgfx::v1::IFont;

// Reusable canvas, sized for the largest native preset (~48px tall). Each font
// draws here, then we crop the PNG to the measured text box.
static LGFX_Sprite canvas;
static const int kCanvasW = 420;
static const int kCanvasH = 80;

// Codepoints that confirm CJK coverage (Hiragana, two common kanji, Hangul).
static const uint16_t kCjkProbe[] = { 0x3042, 0x6F22, 0x4E00, 0xAC00 };

// x_advance of a single codepoint for this font, or -1 if it has no such glyph.
static int advanceOf(const IFont *font, const FontMetrics &base, uint16_t c)
{
  FontMetrics t = base;
  if (!font->updateFontMetric(&t, c)) return -1;
  return (int)t.x_advance;
}

// Whether the font actually draws a glyph for a sample string. updateFontMetric
// reports a metric even for blank/absent glyphs (e.g. Font7 the 7-segment font
// claims to "cover" letters it cannot draw), so coverage is decided by rendering
// and scanning for a lit pixel — the only reliable signal.
static bool drawsGlyph(LGFX_Sprite &cv, const IFont *font, const char *s)
{
  cv.fillScreen(TFT_BLACK);
  cv.setFont(font);
  cv.setTextColor(TFT_WHITE);
  cv.setTextSize(1);
  cv.setCursor(0, 0);
  cv.print(s);
  int w = cv.textWidth(s), h = cv.fontHeight();
  if (w <= 0) w = 8;
  if (w > kCanvasW) w = kCanvasW;
  if (h <= 0 || h > kCanvasH) h = kCanvasH;
  for (int y = 0; y < h; ++y)
    for (int x = 0; x < w; ++x)
      if (cv.readPixel(x, y)) return true;
  return false;
}

// Fixed-pitch (monospace) vs proportional: 1 fixed, 0 proportional, -1 unknown.
// Latin fonts compare 'i' vs 'W'; this also separates the proportional CJK "P"
// variants (whose ASCII is proportional) from the fixed ones. CJK-only fonts
// fall back to comparing full-width/Hangul glyphs.
static int detectMono(const IFont *font, const FontMetrics &base)
{
  int ai = advanceOf(font, base, 'i'), aw = advanceOf(font, base, 'W');
  if (ai > 0 && aw > 0) return ai == aw ? 1 : 0;
  static const uint16_t wide[] = { 0x65E5, 0x3042, 0xD55C, 0xAC00 }; // 日 あ 한 가
  int first = -1;
  for (size_t k = 0; k < sizeof(wide) / sizeof(wide[0]); ++k) {
    int a = advanceOf(font, base, wide[k]);
    if (a <= 0) continue;
    if (first < 0) first = a;
    else if (a != first) return 0;
  }
  return first > 0 ? 1 : -1;
}

static bool savePngCrop(LGFX_Sprite &src, const char *path, int w, int h)
{
  if (w <= 0) w = 1;
  if (h <= 0) h = 1;
  if (w > kCanvasW) w = kCanvasW;
  if (h > kCanvasH) h = kCanvasH;
  size_t len = 0;
  void *png = src.createPng(&len, 0, 0, w, h);
  if (!png || len == 0) return false;
  FILE *fp = fopen(path, "wb");
  bool ok = false;
  if (fp) { ok = (fwrite(png, 1, len, fp) == len); fclose(fp); }
  free(png);
  return ok;
}

void setup()
{
  Serial.begin(115200);
  Serial.println("TEST start font_introspect");

  mkdir("output", 0755);
  mkdir("output/samples", 0755);

  canvas.setColorDepth(16);
  canvas.setPsram(false);
  if (!canvas.createSprite(kCanvasW, kCanvasH)) {
    Serial.println("FATAL createSprite failed");
    return;
  }

  FILE *meta = fopen("output/metrics.jsonl", "wb");
  if (!meta) { Serial.println("FATAL metrics.jsonl"); return; }

  int pngOk = 0;
  for (size_t i = 0; i < kFontCount; ++i) {
    const FontEntry &e = kFonts[i];
    const IFont *font = e.font;

    FontMetrics m;
    font->getDefaultMetric(&m);

    // Printable-ASCII coverage (0x20..0x7E) + CJK probe.
    int ascii = 0;
    for (uint16_t c = 0x20; c <= 0x7E; ++c) {
      FontMetrics t = m;
      if (font->updateFontMetric(&t, c)) ++ascii;
    }
    bool cjk = false;
    for (size_t k = 0; k < sizeof(kCjkProbe) / sizeof(kCjkProbe[0]); ++k) {
      FontMetrics t = m;
      if (font->updateFontMetric(&t, kCjkProbe[k])) { cjk = true; break; }
    }
    int mono = detectMono(font, m);

    // Actual character coverage (rendered, not metric-claimed). Done before the
    // sample render below since these reuse the same canvas. Letters are probed
    // with uppercase "ABC": numeric/clock fonts (Font6) carry only the lowercase
    // am/pm markers a/p/m, so probing 'a' would wrongly flag them as text fonts.
    bool letters = drawsGlyph(canvas, font, "ABC");
    bool digits = drawsGlyph(canvas, font, "0123456789");
    bool latinExt = drawsGlyph(canvas, font, "éÑ"); // Latin-1 accented

    // Render the generated sample (script-appropriate), cropped to its box.
    // Digit-only fonts (e.g. the 7-segment Font7) carry no letters, so the
    // table sample would render only its stray digits — show all ten instead.
    const char *sample = (!letters && digits) ? "0123456789" : e.sample;
    canvas.fillScreen(TFT_BLACK);
    canvas.setFont(font);
    canvas.setTextColor(TFT_WHITE, TFT_BLACK);
    canvas.setTextSize(1);
    canvas.setCursor(0, 0);
    canvas.print(sample);
    int tw = canvas.textWidth(sample) + 2;
    int th = m.height > 0 ? m.height + 2 : canvas.fontHeight() + 2;

    char path[160];
    snprintf(path, sizeof(path), "output/samples/%s.png", e.name);
    bool ok = savePngCrop(canvas, path, tw, th);
    if (ok) ++pngOk;

    const char *monoStr = mono == 1 ? "true" : mono == 0 ? "false" : "null";
    fprintf(meta,
            "{\"name\":\"%s\",\"height\":%d,\"baseline\":%d,\"x_advance\":%d,"
            "\"y_advance\":%d,\"width\":%d,\"ascii\":%d,\"cjk\":%s,\"mono\":%s,"
            "\"letters\":%s,\"digits\":%s,\"latinExt\":%s,"
            "\"sample\":\"%s\",\"sw\":%d,\"sh\":%d,\"png\":%s}\n",
            e.name, (int)m.height, (int)m.baseline, (int)m.x_advance,
            (int)m.y_advance, (int)m.width, ascii, cjk ? "true" : "false", monoStr,
            letters ? "true" : "false", digits ? "true" : "false", latinExt ? "true" : "false",
            sample, tw, th, ok ? "true" : "false");

    if ((i % 32) == 0) Serial.printf("PROGRESS %u/%u\n", (unsigned)i, (unsigned)kFontCount);
  }

  fclose(meta);
  Serial.printf("DONE fonts=%u png=%d\n", (unsigned)kFontCount, pngOk);
  Serial.println("TEST done");
}

void loop() { delay(1000); }
